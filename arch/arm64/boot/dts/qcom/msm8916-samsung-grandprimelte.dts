// SPDX-License-Identifier: GPL-2.0-only

/dts-v1/;

#include "msm8916-samsung-fortuna-common.dtsi"

/ {
	model = "Samsung Galaxy Grand Prime (SM-G530FZ)";
	compatible = "samsung,grandprimelte", "qcom,msm8916";
	chassis-type = "handset";
};
