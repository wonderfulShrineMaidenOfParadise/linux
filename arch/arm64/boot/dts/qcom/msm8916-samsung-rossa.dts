// SPDX-License-Identifier: GPL-2.0-only

/dts-v1/;

#include "msm8916-samsung-rossa-common.dtsi"

/ {
	model = "Samsung Galaxy Core Prime LTE";
	compatible = "samsung,rossa", "qcom,msm8916";
	chassis-type = "handset";
};
