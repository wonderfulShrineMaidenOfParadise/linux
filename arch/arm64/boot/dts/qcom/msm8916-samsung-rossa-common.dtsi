// SPDX-License-Identifier: GPL-2.0-only

#include "msm8916-samsung-fortuna-common.dtsi"

&blsp_i2c1 {
	/* SM5504 MUIC instead of SM5502 */
	/delete-node/ extcon@25;

	muic: extcon@14 {
		compatible = "siliconmitus,sm5504-muic";
		reg = <0x14>;
		interrupts-extended = <&tlmm 12 IRQ_TYPE_EDGE_FALLING>;
		pinctrl-0 = <&muic_int_default>;
		pinctrl-names = "default";
	};
};
