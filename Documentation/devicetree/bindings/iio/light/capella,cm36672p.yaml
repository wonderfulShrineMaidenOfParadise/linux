## Documentation/devicetree/bindings/iio/light/capella,cm36672p.yaml
```yaml
# SPDX-License-Identifier: (GPL-2.0 OR BSD-2-Clause)
%YAML 1.2
---
$id: http://devicetree.org/schemas/iio/light/capella,cm36672p.yaml#
$schema: http://devicetree.org/meta-schemas/core.yaml#

title: Capella CM36672P I2C Proximity sensor

maintainers:
  - Raymond Hackley <raymondhackley@protonmail.com>

properties:
  compatible:
    const: capella,cm36672p

  reg:
    maxItems: 1

  interrupts:
    maxItems: 1

  vdd-supply:
    description: |
      VDD supply voltage.

  vio-supply:
    description: |
      I/O supply voltage.

  vled-supply:
    description: |
      Supply for the IR_LED which is part of the cm36672p for proximity detection.

  cm36672p,smart-pers:
    description: smart-pers varaint.
    type: boolean

additionalProperties: false

required:
  - compatible
  - reg
  - interrupts
  - vled-supply

examples:
  - |
    i2c {
        #address-cells = <1>;
        #size-cells = <0>;

        proximity@60 {
            compatible = "capella,cm36672p";
            reg = <0x60>;
            interrupt-parent = <&msmgpio>;
            interrupts = <113 IRQ_TYPE_EDGE_FALLING>;
            vled-supply = <&reg_proximity_vled>;
        };
    };
...
```

## Documentation/devicetree/bindings/mfd/siliconmitus,sm5703.yaml
```yaml
# SPDX-License-Identifier: GPL-2.0-only OR BSD-2-Clause
%YAML 1.2
---
$id: http://devicetree.org/schemas/mfd/siliconmitus,sm5703.yaml#
$schema: http://devicetree.org/meta-schemas/core.yaml#

title: Silicon Mitus SM5703 multi-function device bindings

maintainers:
  - Markuss Broks <markuss.broks@gmail.com>

description: |
  Silicon Mitus SM5703 is a multi-function device, that consists of several
  modules, designed for a mobile phone use. It consists of
  LDO, Buck, USBLDO and VBUS regulators, a flash LED driver, a MUIC unit,
  a fuel gauge and a battery charger circuit. The MUIC and Fuel-Gauge units
  are separate from the main MFD, having their own i2c lines, while the
  LED driver, regulators and charger are sharing the main i2c bus of the MFD.

properties:
  compatible:
    const: siliconmitus,sm5703

  reg:
    description:
      I2C slave address.
    maxItems: 1

  regulators:
    $ref: /schemas/regulator/siliconmitus,sm5703-regulator.yaml
    description:
      List of child nodes that specify the regulators.

  reset-gpios:
    description:
      GPIO which is connected to the MRSTB pin.
    maxItems: 1

required:
  - compatible
  - reg
  - regulators
  - reset-gpios

additionalProperties: false

examples:
  - |
    #include <dt-bindings/gpio/gpio.h>
    i2c {
        #address-cells = <1>;
        #size-cells = <0>;
        pmic@49 {
          compatible = "siliconmitus,sm5703";
          reg = <0x49>;

          reset-gpios = <&msmgpio 24 GPIO_ACTIVE_HIGH>;
          pinctrl-0 = <&mrstb_default>;

          regulators {
            sm5703_ldo1: ldo1 {
              regulator-min-microvolt = <2800000>;
              regulator-max-microvolt = <2800000>;
            };

            sm5703_ldo2: ldo2 {
              regulator-min-microvolt = <1500000>;
              regulator-max-microvolt = <3300000>;
            };

            sm5703_ldo3: ldo3 {
              regulator-min-microvolt = <3300000>;
              regulator-max-microvolt = <3300000>;
            };

            sm5703_usbldo1: usbldo1 { };

            sm5703_usbldo2: usbldo2 { };

            sm5703_vbus: vbus { };
          };
        };
      };
...
```
